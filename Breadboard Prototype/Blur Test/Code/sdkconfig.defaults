## Breadboard Prototype/Blur Test/Code/sdkconfig.defaults
```kconfig
CONFIG_COMPILER_OPTIMIZATION_PERF=y
CONFIG_ESP32P4_SELECTS_REV_LESS_V3=y
CONFIG_ESP32P4_REV_MIN_100=y
CONFIG_ESPTOOLPY_FLASHSIZE_16MB=y
CONFIG_ESPTOOLPY_FLASHSIZE="16MB"
CONFIG_ESP_CONSOLE_USB_SERIAL_JTAG=y
CONFIG_ESP_CONSOLE_SECONDARY_NONE=y
CONFIG_FATFS_LFN_HEAP=y
CONFIG_SPIRAM=y
CONFIG_CAMERA_SC2336=y
CONFIG_CAMERA_SC2336_AUTO_DETECT_MIPI_INTERFACE_SENSOR=y
CONFIG_CAMERA_SC2336_MIPI_RAW10_1920X1080_25FPS_2_LANE=y
CONFIG_CAMERA_SC2336_MIPI_RAW10_1920X1080_30FPS=y
CONFIG_CAMERA_SC2336_MIPI_DEFAULT_FMT_RAW10_1920X1080_30FPS=y
CONFIG_CAMERA_SC2336_DEFAULT_IPA_JSON_CONFIGURATION_FILE=y
CONFIG_ESP_VIDEO_ENABLE_ISP=y
CONFIG_ESP_VIDEO_ENABLE_DATA_PREPROCESSING=y
CONFIG_ESP_VIDEO_CHECK_PARAMETERS=y
CONFIG_ESP_VIDEO_ENABLE_MIPI_CSI_VIDEO_DEVICE=y
CONFIG_ESP_VIDEO_DISABLE_MIPI_CSI_DRIVER_BACKUP_BUFFER=y
CONFIG_ESP_VIDEO_ENABLE_ISP_VIDEO_DEVICE=y
CONFIG_ESP_VIDEO_ENABLE_ISP_PIPELINE_CONTROLLER=y
CONFIG_CAMERA_OV5647=y
CONFIG_CAMERA_OV5647_AUTO_DETECT_MIPI_INTERFACE_SENSOR=y
CONFIG_CAMERA_OV5647_MIPI_RAW10_1280X960_BINNING_45FPS=y
CONFIG_CAMERA_OV5647_MIPI_RAW10_1280X960_BINNING_15FPS=y
CONFIG_CAMERA_OV5647_MIPI_DEFAULT_FMT_RAW10_1280X960_BINNING_15FPS=y
CONFIG_CAMERA_OV5647_CSI_LINESYNC_ENABLE=y
CONFIG_CAMERA_OV5647_CUSTOMIZED_IPA_JSON_CONFIGURATION_FILE=y
CONFIG_CAMERA_OV5647_CUSTOMIZED_IPA_JSON_CONFIGURATION_FILE_PATH="main/ov5647_custom.json"

CONFIG_ESP_VIDEO_ENABLE_HW_JPEG_ENC_VIDEO_DEVICE=n
CONFIG_ESP_VIDEO_ENABLE_JPEG_ENC_VIDEO_DEVICE=n
CONFIG_ESP_VIDEO_ENABLE_H264_VIDEO_DEVICE=n
CONFIG_ESP_VIDEO_ENABLE_USB_UVC_VIDEO_DEVICE=n
CONFIG_FREERTOS_HZ=1000
# Captures include a synchronous JPEG encode and SD write. Allow that
# operation time to complete while capture_save services the watchdog.
CONFIG_ESP_TASK_WDT_TIMEOUT_S=20
CONFIG_TASK_WDT_TIMEOUT_S=20
CONFIG_ESP_MAIN_TASK_STACK_SIZE=8192
CONFIG_PARTITION_TABLE_SINGLE_APP_LARGE=y
# Match the existing SC2336 board's development-encrypted flash. This is
# firmware encryption only; SD-card JPEGs stay plaintext. Require provisioned
# hardware so a replacement board is never automatically provisioned.
CONFIG_PARTITION_TABLE_OFFSET=0x9000
CONFIG_SECURE_FLASH_ENC_ENABLED=y
CONFIG_SECURE_FLASH_ENCRYPTION_MODE_DEVELOPMENT=y
CONFIG_SECURE_FLASH_REQUIRE_ALREADY_ENABLED=y

CONFIG_TINYUSB_MSC_ENABLED=y
CONFIG_TINYUSB_MSC_BUFSIZE=8192
CONFIG_TINYUSB_MSC_MOUNT_PATH="/sdcard"
CONFIG_TINYUSB_DESC_PRODUCT_STRING="Blur Test SD Card"
```

## Development Board Prototype/IMU Test/Code/sdkconfig.defaults
```kconfig
# ESP32-P4 rev v1.0 compatibility profile.
CONFIG_ESP32P4_SELECTS_REV_LESS_V3=y
CONFIG_ESP32P4_REV_MIN_100=y
CONFIG_ESP_DEFAULT_CPU_FREQ_MHZ_360=y
CONFIG_ESPTOOLPY_FLASHSIZE_16MB=y
CONFIG_ESPTOOLPY_FLASHSIZE="16MB"
# CONFIG_ESP_CONSOLE_UART_DEFAULT is not set
CONFIG_ESP_CONSOLE_USB_SERIAL_JTAG=y
# CONFIG_ESP_CONSOLE_SECONDARY_USB_SERIAL_JTAG is not set
CONFIG_ESP_CONSOLE_SECONDARY_NONE=y
```
